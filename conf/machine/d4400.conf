## conf/machine/d4400.conf
```bitbake
#@TYPE: Machine
#@NAME: i.MX6Q
#@DESCRIPTION: Machine configuration for Freescale

include conf/machine/include/fsl-dfe-base.inc
include conf/machine/include/tune-cortexa9.inc
include conf/machine/include/fsl-dfe-release.inc

SOC_FAMILY = "mx6:mx6q"


PREFERRED_PROVIDER_virtual/kernel_d4400 ?= "linux-dfe"
PREFERRED_PROVIDER_u-boot_d4400 ?= "u-boot-dfe"

PEFERRED_VERSION_virtual/kernel_linux-dfe ?= "3.8.4"
PEFERRED_VERSION_u-boot_u-boot-dfe ?= "2013.04"

KERNEL_DEVICETREE = "${S}/arch/arm/boot/dts/d4400-evb.dts"
KERNEL_DEFCONFIG = "${S}/arch/arm/configs/d4400_evb_defconfig"
UBOOT_MACHINE = "d4400_evb_config"
# Set specific make target and binary suffix
UBOOT_MAKE_TARGET = "all"
UBOOT_SUFFIX ?= "d4400"
UBOOT_BINARY ?= "u-boot-sha256.${UBOOT_SUFFIX}"
UBOOT_IMAGE ?= "u-boot-sha256-${DATETIME}.${UBOOT_SUFFIX}"
UBOOT_ENTRYPOINT = "0x17800000"
KERNEL_EXTRA_ARGS = "LOADADDR=0x90008000 -j3"

ROOTFS_POSTPROCESS_COMMAND += "cd ${IMAGE_ROOTFS} ; rm -rf home ; ln -s mnt/pfs/home home ; mkdir -m 755 mnt/pfs ; "
ROOTFS_POSTPROCESS_COMMAND += "cd ${IMAGE_ROOTFS} ; ln -s /mnt/pfs/etc/init.d/custom_init.sh etc/rcS.d/S36custom_init.sh ; "
ROOTFS_POSTPROCESS_COMMAND += "cd ${IMAGE_ROOTFS} ; cd etc ; unlink syslog-startup.conf; ln -s mysyslog.conf syslog-startup.conf ; cd .. ; "
CORE_IMAGE_EXTRA_INSTALL  += "swig lua5.1 ncurses readline rrh-utils openssh ethtool mtd-utils nano perf"
```

## conf/machine/include/fsl-dfe-base.inc
```bitbake
# Provides the i.MX common settings
include conf/machine/include/soc-family.inc
IMAGE_CLASSES = "image_types_uboot"


# Disable perf features as 2.6.35.3 fail to build otherwise
PERF_FEATURES_ENABLE = ""



IMAGE_FEATURES += "dev-pkgs"
# Ship kernel modules
MACHINE_EXTRA_RRECOMMENDS = "kernel-modules"

JFFS2_ERASEBLOCK = "0x20000"
EXTRA_IMAGECMD_jffs2 = "--pad --little-endian -s 0x400 --eraseblock=${JFFS2_ERASEBLOCK} --no-cleanmarkers"

# Extra udev rules
MACHINE_EXTRA_RRECOMMENDS += "udev-extraconf rrh-utils"

EXTRA_IMAGEDEPENDS = "u-boot"

IMAGE_FSTYPES = "ext2.gz"
SERIAL_CONSOLE = "115200 ttymxc3"

KERNEL_IMAGETYPE = "zImage"
```

## conf/machine/include/fsl-dfe-release.inc
```bitbake
SRCREV_pn-linux-dfe ?= "${AUTOREV}"
SRC_URI_pn-linux-dfe ?= "git://git.am.freescale.net/gitolite/users/b34330/linux.git;protocol=git;branch=sdk_dfe_dev"

SRCREV_pn-rrh-utils ?= "${AUTOREV}"
SRC_URI_pn-rrh-utils ?= "git://git.am.freescale.net/gitolite/users/b34330/rrh_utils.git;protocol=git;branch=sdk_dfe_dev"


#SRC_URI_pn-rrh-utils ?= "git:///home/r39151/dfe/rrh_utils.no_lua_hdrs;protocol=file;branch=sdk_dfe_dev"

SRCREV_pn-u-boot-dfe ?= "${AUTOREV}"
SRC_URI_pn-u-boot-dfe ?= "git://git.am.freescale.net/gitolite/users/b34330/u-boot.git;protocol=git;branch=sdk_dfe_dev"
```

## recipes-utils/makeitb/files/kernel_fit.its
```
/*
 * U-boot kernel_fit source file with  kernel, ramdisk and FDT blob
 */

/dts-v1/;

/ {
	description = "kernel, ramdisk and FDT blob";
	#address-cells = <1>;

	images {
		kernel@1 {
			description = "Linux-3.8.4-rt2+";
			data = /incbin/("./zImage");
			type = "kernel";
			arch = "arm";
			os = "linux";
			compression = "none";
			load = <0x90008000>;
			entry = <0x90008000>;
			hash@1{
				algo = "crc32";
			};
			hash@2{
				algo = "sha1";
			};
		};
		ramdisk@1 {
			description = "rootfs.ext2.gz";
			data = /incbin/("./rootfs.ext2.gz");
			type = "ramdisk";
			arch = "arm";
			os = "linux";
			compression = "none";
			load = <0xb1c00000>;
			hash@1{
				algo = "crc32";
			};
			hash@2{
				algo = "sha1";
			};
		};
		fdt@1 {
			description = "d4400-evb-fdt";
			data = /incbin/("./d4400-evb.dtb");
			type = "flat_dt";
			arch = "arm";
			compression = "none";
			load = <0xa0ee0000>;
			hash@1{
				algo = "crc32";
			};
			hash@2{
				algo = "sha1";
			};
		};
	};

    configurations {
        default = "config@1";

        config@1 {
            description = "D4400-EVB linux-3.8.4-rt2+ configuration";
            kernel = "kernel@1";
            ramdisk = "ramdisk@1";
            fdt = "fdt@1";
        };
    };

};
```
